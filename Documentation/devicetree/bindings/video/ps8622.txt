## Documentation/devicetree/bindings/video/ps8622.txt
```
ps8622-bridge bindings

Required properties:
	- compatible: "parade,ps8622"
	- reg: first i2c address of the bridge
	- sleep-gpio: OF device-tree gpio specification
	- reset-gpio: OF device-tree gpio specification
	- power-seq-timing: The times for T8, T9, T10, T11, T12, T13, T15 in ms

Optional property:
	- hpd-gpio: OF device-tree gpio specification of the hotplug pin
		    if it is not connected to the dedicated HPD_DP pin

Example:
	ps8622-bridge@48 {
		compatible = "parade,ps8622";
		reg = <0x48>;
		sleep-gpio = <&gpc3 6 1 0 0>;
		reset-gpio = <&gpc3 1 1 0 0>;
		hpd-gpio = <&gpc3 0 0 0 0>;
		power-seq-timing = <10 200 10 5 200 10 600>;
	};
```

## Documentation/devicetree/bindings/video/ptn3460.txt
```
ptn3460-bridge bindings

Required properties:
	- compatible: "nxp,ptn3460"
	- reg: i2c address of the bridge
	- powerdown-gpio: OF device-tree gpio specification
	- reset-gpio: OF device-tree gpio specification
	- display-timings: Phandle to a display node as described in
		Documentation/devicetree/bindings/video/display-timing.txt

Example:
	ptn3460-bridge@20 {
		compatible = "nxp,ptn3460";
		reg = <0x20>;
		powerdown-gpio = <&gpy2 5 1 0 0>;
		reset-gpio = <&gpx1 5 1 0 0>;
		display-timings = <&lcd_display_timings>;
	};
```

## Documentation/devicetree/bindings/watchdog/samsung-wdt.txt
```
* Samsung's Watchdog Timer Controller

The Samsung's Watchdog controller is used for resuming system operation
after a preset amount of time during which the WDT reset event has not
occured.

Required properties:
- compatible : should be "samsung,s3c2410-wdt"
- reg : base physical address of the controller and length of memory mapped
	region and the optional addresses and length of memory mapped regions
	of PMU registers for masking/unmasking WDT.
- interrupts : interrupt number to the cpu.

Optional properties:
- reset-mask-bit: bit number in the PMU registers to program mask/unmask WDT.

Example:

watchdog {
                compatible = "samsung,s3c2410-wdt";
                reg = <0x101D0000 0x100>, <0x10040408 0x4>, <0x1004040c 0x4>;
                interrupts = <0 42 0>;
                clocks = <&clock 316>;
                clock-names = "watchdog";
                status = "disabled";
                reset-mask-bit = <0>;
        };
```

## drivers/gpu/arm/t6xx/kbase/src/platform/chromebook/Kconfig
```kconfig
#
# (C) COPYRIGHT 2012 ARM Limited. All rights reserved.
#
# This program is free software and is provided to you under the terms of the GNU General Public License version 2
# as published by the Free Software Foundation, and any use by you of this program is subject to the terms of such GNU licence.
#
# A copy of the licence is included with the program, and can also be obtained from Free Software
# Foundation, Inc., 51 Franklin Street, Fifth Floor, Boston, MA  02110-1301, USA.
#
#
if MALI_PLATFORM_THIRDPARTY_NAME = "chromebook"

menu "Chromebook options"
	depends on MALI_T6XX && MALI_EXPERT && MALI_PLATFORM_THIRDPARTY

config T6XX_DVFS_FREQ_LOCK
	bool "Enable dvfs frequency lock support"
	depends on MALI_T6XX_DVFS && MALI_EXPERT
	default n
	help
	  Choose this option to enable locking the DVFS frequency.  If sysfs
	  support is enabled files will be created for inspecting and
	  (potentially) setting a fixed DVFS frequency.  This is used
	  for debugging; enable only if you know what you are doing.

config MALI_HWC_TRACE
	bool "Enable hardware counter event tracing support"
	depends on MALI_T6XX && MALI_EXPERT
	default n
	help
	  Choose this option to enable collecting hardware counter data
	  with system trace events.  This is typically used for debugging
	  but has minimal overhead when not in use. Enable only if you
	  know what you are doing.

endmenu
endif
```

## drivers/gpu/drm/bridge/Kconfig
```kconfig
config DRM_PTN3460
	tristate "PTN3460 DP/LVDS bridge"
	depends on DRM && I2C
	---help---
	  Adds the driver for the NXP PTN3460 DP/LVDS bridge chip.

config DRM_PS8622
	tristate "Parade eDP/LVDS bridge"
	---help---
	  Adds the driver for the Parade PS8622 eDP/LVDS bridge chip.

config DRM_ANX7808
       tristate "Analogix Slimport transmitter ANX7808 support"
       ---help---
	 Slimport Transmitter is a HD video transmitter chip
	 over micro-USB connector for smartphone device.
```

## drivers/staging/android/Kconfig
```kconfig
menu "Android"

if ANDROID

config ASHMEM
	bool "Enable the Anonymous Shared Memory Subsystem"
	default n
	depends on SHMEM || TINY_SHMEM
	help
	  The ashmem subsystem is a new shared memory allocator, similar to
	  POSIX SHM but with different behavior and sporting a simpler
	  file-based API.

config ANDROID_LOGGER
	tristate "Android log driver"
	default n

config ANDROID_TIMED_OUTPUT
	bool "Timed output class driver"
	default y

config ANDROID_TIMED_GPIO
	tristate "Android timed gpio driver"
	depends on GENERIC_GPIO && ANDROID_TIMED_OUTPUT
	default n

config ANDROID_LOW_MEMORY_KILLER
	bool "Android Low Memory Killer"
	default N
	---help---
	  Register processes to be killed when memory is low

config ANDROID_INTF_ALARM_DEV
	bool "Android alarm driver"
	depends on RTC_CLASS
	default n
	help
	  Provides non-wakeup and rtc backed wakeup alarms based on rtc or
	  elapsed realtime, and a non-wakeup alarm on the monotonic clock.
	  Also exports the alarm interface to user-space.

config SYNC
	bool "Synchronization framework"
	default n
	select ANON_INODES
	help
	  This option enables the framework for synchronization between multiple
	  drivers.  Sync implementations can take advantage of hardware
	  synchronization built into devices like GPUs.

config SW_SYNC
	bool "Software synchronization objects"
	default n
	depends on SYNC
	help
	  A sync object driver that uses a 32bit counter to coordinate
	  syncrhronization.  Useful when there is no hardware primitive backing
	  the synchronization.

config SW_SYNC_USER
	bool "Userspace API for SW_SYNC"
	default n
	depends on SW_SYNC
	help
	  Provides a user space API to the sw sync object.
	  *WARNING* improper use of this can result in deadlocking kernel
	  drivers from userspace.

endif # if ANDROID

endmenu
```

## drivers/usb/phy/Kconfig
```kconfig
#
# Physical Layer USB driver configuration
#
comment "USB Physical Layer drivers"
	depends on USB || USB_GADGET

config OMAP_USB2
	tristate "OMAP USB2 PHY Driver"
	depends on ARCH_OMAP2PLUS
	select USB_OTG_UTILS
	help
	  Enable this to support the transceiver that is part of SOC. This
	  driver takes care of all the PHY functionality apart from comparator.
	  The USB OTG controller communicates with the comparator using this
	  driver.

config USB_ISP1301
	tristate "NXP ISP1301 USB transceiver support"
	depends on USB || USB_GADGET
	depends on I2C
	help
	  Say Y here to add support for the NXP ISP1301 USB transceiver driver.
	  This chip is typically used as USB transceiver for USB host, gadget
	  and OTG drivers (to be selected separately).

	  To compile this driver as a module, choose M here: the
	  module will be called isp1301.

config MV_U3D_PHY
	bool "Marvell USB 3.0 PHY controller Driver"
	depends on USB_MV_U3D
	select USB_OTG_UTILS
	help
	  Enable this to support Marvell USB 3.0 phy controller for Marvell
	  SoC.

config USB_RCAR_PHY
	tristate "Renesas R-Car USB phy support"
	depends on USB || USB_GADGET
	select USB_OTG_UTILS
	help
	  Say Y here to add support for the Renesas R-Car USB phy driver.
	  This chip is typically used as USB phy for USB host, gadget.
	  This driver supports: R8A7779

	  To compile this driver as a module, choose M here: the
	  module will be called rcar-phy.

config SAMSUNG_USB2PHY
	tristate "Samsung USB 2.0 PHY controller Driver"
	select SAMSUNG_USBPHY
	select USB_OTG_UTILS
	help
	  Enable this to support Samsung USB 2.0 (High Speed) PHY controller
	  driver for Samsung SoCs.

config SAMSUNG_USB3PHY
	tristate "Samsung USB 3.0 PHY controller Driver"
	select SAMSUNG_USBPHY
	select USB_OTG_UTILS
	help
	  Enable this to support Samsung USB 3.0 (Super Speed) phy controller
	  for samsung SoCs.

config SAMSUNG_USBPHY
	tristate "Samsung USB PHY Driver"
	help
	  Enable this to support Samsung USB phy helper driver for Samsung SoCs.
	  This driver provides common interface to interact, for Samsung USB 2.0 PHY
	  driver and later for Samsung USB 3.0 PHY driver.
```
