## Documentation/devicetree/bindings/power_supply/battery-system.txt
```
SBS sbs-battery
~~~~~~~~~~

Required properties :
 - compatible = "google,battery-system";
 - google,polling-interval-ms : Interval between polling of the battery (ms)
 - google,polling-mode : when to poll the battery:
	"disable" : never poll
	"always" : always poll
	"external-power" : poll when external power is connected
	"charging" : poll when charging
 - google.fullbattery-uv : Number of microvolts expected when all batteries
	are full
 - google,battery-present : How to determine whether battery is present:
	"no" : Battery is never present
	"always" : Battery is always present
	"fuel-guage" : Ask the fuel guage
	"charger" : Ask the charger
 - google,regulators : List of regulators that control power to the battery.
	These will be turned on when charging is required.
 - google,fuel_guage : Fuel guage to use for checking battery system charge
	level
 - google,temperature-high : Maximum temperature to permit charging, in
	millidegrees celsius. Above this, charging is terminated.
 - google,temperature-high-recovery : If temperature drops back down to this
	level, we resume charging.
 - google,temperature-low : Lowest temperature to permit charging - after
	this we disable charging
 - google,temperature-low-recovery : If temperature rises to this level, we
	resume charging

Optional properties :
 - google,voltage-drop-ms : time to wait for voltage drop (ms)
 - google,voltage-drop-uv = <100000>;
	Charger Manager checks voltage drop after the battery
	"FULL" event. First it waits for the given number of milliseconds,
	then it checks whether the voltage has dropped more than
	the given number of microvolts. If so, charging is started.
 - google,battery-knows-temperature : Get temperature from the battery
	pack itself (sbs-specification)
 - google,battery-knows-online : Get online state from the battery. Normally
	we would ask the charger (regulator) but if it does not know, then
	in extremis we can ask the battery (sbs-specification)
 - google,assume-online : Include this boolean property if there is no way
	to determine whether the charger is online (plugged into an external
	power source). This can happen with some broken systems.

Example:

battery-system {
	compatible = "google,battery-system";
	google,polling-interval-ms = <30000>;
	google,polling-mode = "always";
	google,voltage-drop-ms = <30000>;
	google,voltage-drop-uv = <100000>;
	google.fullbattery-uv = <42000000>;
	google,battery-present = "fuel-guage";
	google,regulators = <&tps65090_charger>;
	google,fuel_guage = <&battery>;
	google,temperature-high = <63000>;
	google,temperature-high-recovery = <58000>;
	google,temperature-low = <-5000>;
	google,temperature-low-recovery = <0>;
	google,battery-knows-temperature;
	google,battery-knows-online;
	google,assume-online;
};

battery : sbs-battery@b {
	compatible = "sbs,sbs-battery";
	reg = <0xb>;
	sbs,poll-retry-count = <3>;
};

tps65090_charger : charger {
	tps65090-control-reg-offset = <4>;
	regulator-name = "vinchg";
};
```

## Documentation/devicetree/bindings/power_supply/tps65090-charger.txt
```
TI TPS65090 Charger
===================

Regulator information exists as a subnode within the mfd node for the main
TPS65090 device.

The TPS65090 regulator subnode should be called "charger".

The required properties for the individual regulator nodes are as for
regulator.txt, with the following additions / changes:

Optional properties:
  - regulator-name : If given then a regulator is created for the charger
       control. If omitted then the regulator is not created and the driver
       operates entirely passively.

Example:

power-regulator {
	compatible = "ti,tps65090";
	reg = <0x48>;
	charger {
		regulator-name = "vinchg";
	};
};
```

## Documentation/devicetree/bindings/regulator/locker-regulator.txt
```
Locker Voltage regulators

Required properties:
- compatible: Must be "regulator-locker";
- Must have atleast 2 vinX-supply nodes
- Must have atleast 2 vout nodes
- Must have maximum-spread
- The counting for vout and vinX-supplies starts from 1 as shown below

Any property defined as part of the core regulator
binding, defined in regulator.txt, can also be used.

Example:

       int-voltage-locker {
               compatible = "regulator-locker";
               vin1-supply = <&buck2_reg>; /* real vdd_arm */
               vin2-supply = <&buck3_reg>; /* real vdd_int */
               maximum-spread = <300000>;
               locker-regulators {
                       vout1 {
                               regulator-name = "vdd_arm";
                               regulator-min-microvolt = <800000>;
                               regulator-max-microvolt = <1500000>;
                               regulator-always-on;
                               regulator-boot-on;
                       };
                       vout2 {
                               regulator-name = "vdd_int";
                               regulator-min-microvolt = <800000>;
                               regulator-max-microvolt = <1400000>;
                               regulator-always-on;
                               regulator-boot-on;
                       };
               };
       };
```

## Documentation/devicetree/bindings/regulator/s2mps11.txt
```
* Samsung S2MPS11 Voltage and Current Regulator

The Samsung S2MP211 is a multi-function device which includes volatage and
current regulators, rtc, charger controller and other sub-blocks. It is
interfaced to the host controller using a i2c interface. Each sub-block is
addressed by the host system using different i2c slave address. This document
describes the bindings for 'pmic' sub-block of s2mps11.

Required properties:
- compatible: Should be "samsung,s2mps11-pmic".
- reg: Specifies the i2c slave address of the pmic block. It should be 0x66.

Optional properties:
- interrupt-parent: Specifies the phandle of the interrupt controller to which
  the interrupts from s2mps11 are delivered to.
- interrupts: Interrupt specifiers for interrupt sources.
- ramp_delay: Ramp delay for BUCKs.
- ramp_enable: The ramp delay enable/disable control.

Regulators: The regulators of s2mps11 that have to be instantiated should be
included in a sub-node named 'regulators'. Regulator nodes included in this
sub-node should be of the format as listed below.

	regulator_name {
		standard regulator bindings here
	};

The following are the names of the regulators that the s2mps11 pmic block
supports. Note: The 'n' in LDOn and BUCKn represents the LDO or BUCK number
as per the datasheet of s2mps11.

	- LDOn
		  - valid values for n are 1 to 28
		  - Example: LDO0, LD01, LDO28
	- BUCKn
		  - valid values for n are 1 to 9.
		  - Example: BUCK1, BUCK2, BUCK9

The bindings inside the regulator nodes use the standard regulator bindings
which are documented elsewhere.

Example:

	s2mps11_pmic@66 {
		compatible = "samsung,s2mps11-pmic";
		reg = <0x66>;
		s2mps11,buck2-ramp-delay = <12>;
		s2mps11,buck6-ramp-enable = <1>;

		regulators {
			ldo1_reg: LDO1 {
				regulator-name = "VDD_ABB_3.3V";
				regulator-min-microvolt = <3300000>;
				regulator-max-microvolt = <3300000>;
			};

			ldo2_reg: LDO2 {
				regulator-name = "VDD_ALIVE_1.1V";
				regulator-min-microvolt = <1100000>;
				regulator-max-microvolt = <1100000>;
				regulator-always-on;
			};

			buck1_reg: BUCK1 {
				regulator-name = "VDD_MIF_1.2V";
				regulator-min-microvolt = <950000>;
				regulator-max-microvolt = <1350000>;
				regulator-always-on;
				regulator-boot-on;
			};
		};
	};
```

## Documentation/devicetree/bindings/regulator/tps65090-regulator.txt
```
TI TPS65090 Regulator
=====================

Regulator information exists as a subnode within the mfd node for the main
TPS65090 device.

The TPS65090 regulator subnode should be called "voltage-regulators" and
in turn has one subnode for each regulator (generally just a FET).

The required properties for the individual regulator nodes are as for
regulator.txt, with the following additions / changes:

Required properties :
 - tps65090-control-reg-offset : Register offset that controls this
	regulator.

Example:

power-regulator {
	compatible = "ti,tps65090";
	reg = <0x48>;

	voltage-regulators {
		VFET1 {
			tps65090-control-reg-offset = <15>;
			regulator-name = "vcd_led";
			regulator-min-microvolt = <12000000>;
			regulator-max-microvolt = <12000000>;
		};
		VFET2 {
			tps65090-control-reg-offset = <16>;
			regulator-name = "video_mid";
			regulator-min-microvolt = <5000000>;
			regulator-max-microvolt = <5000000>;
		};
		VFET3 {
			tps65090-control-reg-offset = <17>;
			regulator-name = "wwan_r";
			regulator-min-microvolt = <3300000>;
			regulator-max-microvolt = <3300000>;
			regulator-always-on;
		};
		VFET4 {
			tps65090-control-reg-offset = <18>;
			regulator-name = "sdcard";
			regulator-min-microvolt = <3300000>;
			regulator-max-microvolt = <3300000>;
		};
		VFET5 {
			tps65090-control-reg-offset = <19>;
			regulator-name = "camout";
			regulator-min-microvolt = <3300000>;
			regulator-max-microvolt = <3300000>;
			regulator-always-on;
		};
		VFET6 {
			tps65090-control-reg-offset = <20>;
			regulator-name = "lcd_vdd";
			regulator-min-microvolt = <3300000>;
			regulator-max-microvolt = <3300000>;
		};
		VFET7 {
			tps65090-control-reg-offset = <21>;
			regulator-name = "ts";
			regulator-min-microvolt = <5000000>;
			regulator-max-microvolt = <5000000>;
		};
	};
};
```

## Documentation/devicetree/bindings/rtc/max77686-rtc.txt
```
* MAX77686 Real Time Clock controller

This RTC is part of the MAX77686 MFD, which also includes a PMIC device.
The RTC part is in a subnode:

Required properties:
- name: "rtc"

(no other properties are defined at present)

Example:

	max77686 {
		voltage-regulators {
			...
		};
		rtc {
		};
	};
```

## Documentation/devicetree/bindings/sound/daisy-audio-max98095.txt
```
Google Daisy audio complex

Required properties:
- compatible : "google,daisy-audio-max988095" or "google,daisy-audio-max98090"

Optional properties:
- samsung,hp-det-gpios : The GPIO that detects when headphones are plugged in.
- samsung,mic-det-gpios : The GPIO that detects when mic is plugged in.
- card-name : The name that we'll report for the sound card.  If not present
              will be "DAISY-I2S".

Example:

sound {
	compatible = "google,daisy-audio-max98095";

	samsung,mic-det-gpios = <&gpx2 0 2 0 0>;
	samsung,hp-det-gpios = <&gpx2 2 2 0 0>;
	card-name = "DAISY-I2S-98095";
};
```

## Documentation/devicetree/bindings/sound/max98095.txt
```
MAXIM 98095 audio CODEC

Required properties:

  - compatible : "maxim,max98095"

  - reg : the I2C address of the device.

Optional properties:

  - mic-left-digital :  specifies if the left microphone is a DMIC
			instead of analog
  - mic-right-digital : specifies if the right microphone is a DMIC
			instead of analog
  - mclk-pin :  specifies which MCLKx pin is used to provide the codec clock
		1 for MCLK1, 2 for MCLK2/GPIO3.

Example:

codec: max98095@11 {
	compatible = "maxim,max98095";
	reg = <0x11>;

	mic-left-digital;
	mic-righ-digital;
	mclk-pin = <1>;
};
```

## Documentation/devicetree/bindings/sound/samsung-i2s.txt
```
* Samsung I2S controller

Required SoC Specific Properties:

- compatible : "samsung,samsung-i2s"
- reg: physical base address of the controller and length of memory mapped
  region.

[PRELIMINARY: the dma channel allocation will change once there are
official DMA bindings]

- tx-dma-channel-secondary: The dma channel specifier for secondary tx
  operations. The format of the dma specifier depends on the dma
  controller.
- tx-dma-channel: The dma channel specifier for tx operations. The format of
  the dma specifier depends on the dma controller.
- rx-dma-channel: The dma channel specifier for rx operations. The format of
  the dma specifier depends on the dma controller.

Optional SoC Specific Properties:

- samsung,supports-6ch: If the I2S Primary sound source has 5.1 Channel
  support, this flag is enabled.
- samsung,supports-rstclr: This flag should be set if I2S software reset bit
  control is required. When this flag is set I2S software reset bit will be
  enabled or disabled based on need.
- samsung,supports-secdai:If I2S block has a secondary FIFO and internal DMA,
  then this flag is enabled.
- samsung,idma-addr: Internal DMA register base address of the audio
  sub system(used in secondary sound source).

- pinctrl-0: Should specify pin control groups used for this controller.
- pinctrl-names: Should contain only one value - "default".

Aliases:

- All the I2S controller nodes are represented in the aliases node using
  the following format 'i2s{n}' where n is a unique number for the alias.

Example:

- SoC Specific Portion:

i2s@03830000 {
	compatible = "samsung,samsung-i2s";
	reg = <0x03830000 0x100>;
	tx-dma-channel-secondary = <&pdma0 8>;
	tx-dma-channel = <&pdma0 10>;
	rx-dma-channel = <&pdma0 9>;
	samsung,supports-6ch;
	samsung,supports-rstclr;
	samsung,supports-secdai;
	samsung,idma-addr = <0x03000000>;
	pinctrl-names = "default";
	pinctrl-0 = <&i2s0_bus>;
};
```

## Documentation/devicetree/bindings/thermal/exynos-thermal.txt
```
* Exynos Thermal

Required properties:
- compatible: should be one of the following.
    * "samsung,exynos4210-tmu" - for controllers compatible with exynos4210 tmu.
    * "samsung,exynos5250-tmu" - for controllers compatible with exynos5250 tmu.
    * "samsung,exynos5420-tmu" - for controllers compatible with exynos5420 tmu.

- reg: physical base address of the controller and length of
  memory mapped region.

    ** NOTE FOR EXYNOS5420 **
    TRIMINFO register is being misplaced for TMU channels 2, 3 and 4

    TERMINFO for TMU channel 2 is present in address space of TMU channel 3
    TERMINFO for TMU channel 3 is present in address space of TMU channel 4
    TERMINFO for TMU channel 4 is present in address space of TMU channel 2

    * In such cases the reg property contains the misplaced register address and
      range as the second parameter.

- interrupts : interrupt number to the cpu.
- clocks : Clock number as per common clock framework for the cpu.  In the
  case of Exynos5420, a second clock may be specified if the TRIMINFO register
  is located on a separate TMU.
- clock-names : "tmu_apbif" for the TMU's gate clock and, if necessary,
  "tmu_apbif_triminfo" for the gate clock of the TMU which contains this TMU's
  TRIMINFO register.

Example:

	/* tmu for CPU0 */
	tmu@10060000 {
		compatible = "samsung,exynos5420-tmu";
		reg = <0x10060000 0x100>;
		interrupts = <0 65 0>;
		clocks = <&clock 318>;
		clock-names = "tmu_apbif";
	};

Example: In case of Exynos5420 TMU channel 3

	/* tmu for CPU3 */
	tmu@1006c000 {
		compatible = "samsung,exynos5420-tmu";
		/* 2nd reg is for the misplaced TRIMINFO register */
		reg = <0x1006c000 0x100>, <0x100a0000 0x4>;
		interrupts = <0 185 0>;
		clocks = <&clock 318>, <&clock 319>;
		clock-names = "tmu_apbif", "tmu_apbif_triminfo";
	};
```

## Documentation/devicetree/bindings/usb/dwc3.txt
```
synopsys DWC3 CORE

DWC3- USB3 CONTROLLER

Required properties:
 - compatible: must be "synopsys,dwc3"
 - reg : Address and length of the register set for the device
 - interrupts: Interrupts used by the dwc3 controller.
 - usb2-phy : phandle for the USB 2.0 PHY device
 - usb3-phy : phandle for the USB 3.0 PHY device

Optional properties:
 - tx-fifo-resize: determines if the FIFO *has* to be reallocated.

This is usually a subnode to DWC3 glue to which it is connected.

dwc3@4a030000 {
	compatible = "synopsys,dwc3";
	reg = <0x4a030000 0xcfff>;
	interrupts = <0 92 4>
	usb2-phy = <&usb2_phy>;
	usb3-phy = <&usb3_phy>;
	tx-fifo-resize;
};
```
