## Documentation/devicetree/bindings/usb/exynos-ehci.txt
```
Exynos USB EHCI controllers

Required properties:
  - compatible : should be "samsung,exynos-ehci".
  - reg : should contain at least address and length of the standard EHCI
    register set for the device.
  - interrupts : one EHCI interrupt should be described here.

Optional properties:
  - samsung,vbus-gpio : OF gpio specification of the pin which needs to be
    activated for the bus to be powered.
  - samsung,port_used_bitmap : defined which port should be enabled on the
    root hub.

Example:
	ehci {
		compatible = "samsung,exynos-ehci";
		reg = <0x12110000 0x100>;
		interrupts = <0 71 0>;
		samsung,vbus-gpio = <&gpx1 1 1 3 3>;
		samsung,port_used_bitmap = <0x2>;
	};
```

## Documentation/devicetree/bindings/usb/samsung-usbphy.txt
```
SAMSUNG USB-PHY controllers

** Samsung's usb 2.0 phy transceiver

The Samsung's usb 2.0 phy transceiver is used for controlling
usb 2.0 phy for s3c-hsotg as well as ehci-s5p and ohci-exynos
usb controllers across Samsung SOCs.
TODO: Adding the PHY binding with controller(s) according to the under
development generic PHY driver.

Required properties:

Exynos4210:
- compatible : should be "samsung,exynos4210-usb2phy"
- reg : base physical address of the phy registers and length of memory mapped
	region.
- clocks: Clock IDs array as required by the controller.
- clock-names: names of clock correseponding IDs clock property as requested
	       by the controller driver.

Exynos5250:
- compatible : should be "samsung,exynos5250-usb2phy"
- reg : base physical address of the phy registers and length of memory mapped
	region.
- clocks: Clock IDs array as required by the controller.
- clock-names: names of clock correseponding IDs clock property as requested
	       by the controller driver.

Exynos5420:
- compatible : should be "samsung,exynos5420-usb2phy"
- reg : base physical address of the phy registers and length of memory mapped
	region.
- clocks: Clock IDs array as required by the controller.
- clock-names: names of clock correseponding IDs clock property as requested
              by the controller driver.

Optional properties:
- #address-cells: should be '1' when usbphy node has a child node with 'reg'
		  property.
- #size-cells: should be '1' when usbphy node has a child node with 'reg'
	       property.
- ranges: allows valid translation between child's address space and parent's
	  address space.

- samsung,hsic-reset-gpio: an active low GPIO pin that resets a device
			   connected to the HSIC port. Useful for things like
			   an on-board SMSC3503 hub.
- pinctrl-0: Pin control group containing the HSIC reset GPIO pin.
- pinctrl-names: Should contain only one value - "default".

- The child node 'usbphy-sys' to the node 'usbphy' is for the system controller
  interface for usb-phy. It should provide the following information required by
  usb-phy controller to control phy.
  - reg : base physical address of PHY_CONTROL registers.
	  The size of this register is the total sum of size of all PHY_CONTROL
	  registers that the SoC has. For example, the size will be
	  '0x4' in case we have only one PHY_CONTROL register (e.g.
	  OTHERS register in S3C64XX or USB_PHY_CONTROL register in S5PV210)
	  and, '0x8' in case we have two PHY_CONTROL registers (e.g.
	  USBDEVICE_PHY_CONTROL and USBHOST_PHY_CONTROL registers in exynos4x).
	  and so on.

Example:
 - Exynos4210

	usbphy@125B0000 {
		#address-cells = <1>;
		#size-cells = <1>;
		compatible = "samsung,exynos4210-usb2phy";
		reg = <0x125B0000 0x100>;
		ranges;

		clocks = <&clock 2>, <&clock 305>;
		clock-names = "xusbxti", "otg";

		samsung,hsic-reset-gpio = <&gpx2 4 1>;
		pinctrl-names = "default";
		pinctrl-0 = <&hsic_reset>;

		usbphy-sys {
			/* USB device and host PHY_CONTROL registers */
			reg = <0x10020704 0x8>;
		};
	};


** Samsung's usb 3.0 phy transceiver

Starting exynso5250, Samsung's SoC have usb 3.0 phy transceiver
which is used for controlling usb 3.0 phy for dwc3-exynos usb 3.0
controllers across Samsung SOCs.

Required properties:

Exynos5250:
- compatible : should be "samsung,exynos5250-usb3phy"
- reg : base physical address of the phy registers and length of memory mapped
	region.
- clocks: Clock IDs array as required by the controller.
- clock-names: names of clocks correseponding to IDs in the clock property
	       as requested by the controller driver.

Exynos5420:
- compatible : should be "samsung,exynos5420-usb3phy"
- reg : base physical address of the phy registers and length of memory mapped
	region.
- clocks: Clock IDs array as required by the controller.
- clock-names: names of clock correseponding IDs clock property as requested
              by the controller driver.

Optional properties:
- #address-cells: should be '1' when usbphy node has a child node with 'reg'
		  property.
- #size-cells: should be '1' when usbphy node has a child node with 'reg'
	       property.
- ranges: allows valid translation between child's address space and parent's
	  address space.

- The child node 'usbphy-sys' to the node 'usbphy' is for the system controller
  interface for usb-phy. It should provide the following information required by
  usb-phy controller to control phy.
  - reg : base physical address of PHY_CONTROL registers.
	  The size of this register is the total sum of size of all PHY_CONTROL
	  registers that the SoC has. For example, the size will be
	  '0x4' in case we have only one PHY_CONTROL register (e.g.
	  OTHERS register in S3C64XX or USB_PHY_CONTROL register in S5PV210)
	  and, '0x8' in case we have two PHY_CONTROL registers (e.g.
	  USBDEVICE_PHY_CONTROL and USBHOST_PHY_CONTROL registers in exynos4x).
	  and so on.

- Aliases: exynos5420 has multiple usb 3.0 phy transceivers interacting with multiple
          dwc3 controllers. So the usb 3.0 phy controller nodes should be represented
          in the aliases node using the following format:
          'usb3phy{n}' where n is a unique number for the alias.

- samsung,txpreempamptune: board specific "HS Transmitter Pre-Emphasis Current
			   Control".
			   Allowed values -- (One unit amount is approximately
			   600uA and is defined as 1X preemphasis current).
			     0x0 (default) = pre-emphasis is disabled.
			     0x1 = 1X pre-emphasis current.
			     0x2 = 2X pre-emphasis current.
			     0x3 = 3X pre-emphasis current.

Example:
	usbphy@12100000 {
		compatible = "samsung,exynos5250-usb3phy";
		reg = <0x12100000 0x100>;
		#address-cells = <1>;
		#size-cells = <1>;
		ranges;

		clocks = <&clock 1>, <&clock 286>;
		clock-names = "ext_xtal", "usbdrd30";

		usbphy-sys {
			/* USB device and host PHY_CONTROL registers */
			reg = <0x10040704 0x8>;
		};
	};
```

## Documentation/devicetree/bindings/video/anx7808.txt
```
anx7808-bridge bindings
-----------------------

The Analogix ANX7808 is a HDMI to MyDP (video over micro-USB) bridge chip.


Required properties:
	- compatible: "analogix,anx7808"
	- reg: first i2c address of the bridge
	- pd-gpio: OF device-tree gpio specification of the power down pin
	- reset-gpio: OF device-tree gpio specification of the reset pin
	- cable-det-gpio: OF device-tree gpio specification of the cable
	  detect pin
	- intp-gpio: OF device-tree gpio specification of the external
	  interrupt pin

Example:
anx7808-bridge@38 {
	compatible = "analogix,anx7808";
	reg = <0x38>;
	pd-gpio = <&gpe0 6 1 0 0>;
	reset-gpio = <&gpe0 7 1 0 0>;
	cable-det-gpio = <&gpx0 7 0 0 0>;
	intp-gpio = <&gpf0 0 0 0 0>;
};
```

## Documentation/devicetree/bindings/video/backlight/pwm-backlight.txt
```
pwm-backlight bindings

Required properties:
  - compatible: "pwm-backlight"
  - pwms: OF device-tree PWM specification (see PWM binding[0])
  - one of "brightness-levels" or "max-brightness", described below
  - default-brightness-level: the default brightness level (index into the array
      defined by the "brightness-levels" property or a value between 0 and
      "max-brightness")

Optional properties:
  - brightness-levels: Array of distinct brightness levels. Typically these
      are in the range from 0 to 255, but any range starting at 0 will do.
      The actual brightness level (PWM duty cycle) will be interpolated
      from these values. 0 means a 0% duty cycle (darkest/off), while the
      last value in the array represents a 100% duty cycle (brightest).
  - max-brightness: Instead of specifying a complete set of brightness
      levels, a single maximum brightness value may be given. This indicates
      that all integers between 0 and max-brightness are valid brightness
      values.
  - pwm-names: a list of names for the PWM devices specified in the
               "pwms" property (see PWM binding[0])

[0]: Documentation/devicetree/bindings/pwm/pwm.txt

Example:

	backlight {
		compatible = "pwm-backlight";
		pwms = <&pwm 0 5000000>;

		brightness-levels = <0 4 8 16 32 64 128 255>;
		default-brightness-level = <6>;
	};
or:
	backlight {
		compatible = "pwm-backlight";
		pwms = <&pwm 0 1000000 0>;

		max-brightness = <1024>;
		default-brightness-level = <700>;
	};
```

## Documentation/devicetree/bindings/video/exynos_dp.txt
```
The Exynos display port interface should be configured based on
the type of panel connected to it.

We use two nodes:
	-dp-controller node
	-dptx-phy node(defined inside dp-controller node)

For the DP-PHY initialization, we use the dptx-phy node.
Required properties for dptx-phy:
	-reg:
		Base address of DP PHY register.
	-samsung,enable-mask:
		The bit-mask used to enable/disable DP PHY.

For the Panel initialization, we read data from dp-controller node.
Required properties for dp-controller:
	-compatible:
		should be "samsung,exynos5-dp".
	-reg:
		physical base address of the controller and length
		of memory mapped region.
	-interrupts:
		interrupt combiner values.
	-interrupt-parent:
		phandle to Interrupt combiner node.
	-samsung,dp-display:
		This property should specify the phandle of the display device
		node which holds the video interface timing with the below
		mentioned properties.
		  -lcd-htiming: Specifies the horizontal timing for the
			overlay. The horizontal timing includes four parameters
			in the following order.
			- horizontal back porch (in number of lcd clocks)
			- horizontal front porch (in number of lcd clocks)
			- hsync pulse width (in number of lcd clocks)
			- Display panels X resolution.

		  -lcd-vtiming: Specifies the vertical timing for the overlay.
			The vertical timing includes four parameters in the
			following order.
			- vertical back porch (in number of lcd lines)
			- vertical front porch (in number of lcd lines)
			- vsync pulse width (in number of lcd clocks)
			- Display panels Y resolution.

		  -lcd-dimensions: Specifies the physical dimensions of the
			attached LCD panel in the following order.
			-width (in mm)
			-height (in mm)
	-samsung,dp-frame-rate:
		Number of video frames per second.
	-samsung,color-space:
		input video data format.
			COLOR_RGB = 0, COLOR_YCBCR422 = 1, COLOR_YCBCR444 = 2
	-samsung,dynamic-range:
		dynamic range for input video data.
			VESA = 0, CEA = 1
	-samsung,ycbcr-coeff:
		YCbCr co-efficients for input video.
			COLOR_YCBCR601 = 0, COLOR_YCBCR709 = 1
	-samsung,color-depth:
		number of bits per colour component.
			COLOR_6 = 0, COLOR_8 = 1, COLOR_10 = 2, COLOR_12 = 3
	-samsung,link-rate:
		link rate supported by the panel.
			LINK_RATE_1_62GBPS = 0x6, LINK_RATE_2_70GBPS = 0x0A
	-samsung,lane-count:
		number of lanes supported by the panel.
			LANE_COUNT1 = 1, LANE_COUNT2 = 2, LANE_COUNT4 = 4

Optional properties for dp-controller:
	-interlaced:
		interlace scan mode.
			Progressive if defined, Interlaced if not defined
	-vsync-active-high:
		VSYNC polarity configuration.
			High if defined, Low if not defined
	-hsync-active-high:
		HSYNC polarity configuration.
			High if defined, Low if not defined
	-edp-need-regulator:
		Use regulator control for eDP panel.
			Use regulator controls if defined.
	-samsung,power-up-delay:
		eDP panel powerup delay value in ms.
			Delay in ms needed for the eDP panel to properly
			powerup after giving powerup signals to the panel.
	-samsung,power-down-delay:
		eDP panel powerdown delay value in ms.
			Delay in ms needed for the eDP panel to properly
			powerdown after giving powerdown signals to the panel.
	-samsung,hpd-gpio:
		Hotplug detect GPIO.
			Indicates which GPIO should be used for hotplug
			detection
	-samsung,lcd-en-gpio:
		eDP panel LCD poweron GPIO.
			Indicates which GPIO needs to be powered up as output
			to powerup the LCD panel.
	-samsung,led-en-gpio:
		eDP panel LED enable GPIO.
			Indicates which GPIO needs to be powered up as output
			to enable the backlight.
	-samsung,skip-edid-read:
		If present we'll skip reading the EDID.

Example:

SOC specific portion:
	dp-controller {
		compatible = "samsung,exynos5-dp";
		reg = <0x145b0000 0x10000>;
		interrupts = <10 3>;
		interrupt-parent = <&combiner>;

		dptx-phy {
			reg = <0x10040720>;
			samsung,enable-mask = <1>;
		};

	};

Board Specific portion:
	lcd_dp0: lcd_panel0 {
			lcd-htiming = <4 4 4 480>;
			lcd-vtiming = <4 4 4 320>;
			lcd-dimensions = <256 144>;
			supports-mipi-panel;
	};

	dp-controller {
		samsung,dp-display = <&lcd_dp0>;
		samsung,dp-frame-rate = <60>;
		samsung,color-space = <0>;
		samsung,dynamic-range = <0>;
		samsung,ycbcr-coeff = <0>;
		samsung,color-depth = <1>;
		samsung,link-rate = <0x0a>;
		samsung,lane-count = <4>;
	};
```
