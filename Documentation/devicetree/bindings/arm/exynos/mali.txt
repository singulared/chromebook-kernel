## Documentation/devicetree/bindings/arm/exynos/mali.txt
```
ARM 3D Graphics IP (Mali T6xx)

The Mali T6xx series IP is present in Samsung Exynos
platforms for enabling 3D grahics acceleration.
The DT node for this IP has to be defined in the following
way:

Required properties:

  - compatible : value should be "arm,mali"
  - reg	: Physical base address of the IP registers and
		length of the memory mapped region.
  - interrupts : ARM Mali interrupts to the CPU.
		Three interrupts are needed which are
		1) JOB IRQ number
		2) MMU IRQ number
		3) GPU IRQ number
  - clocks : From common clock binding : handle to g3d clock and aclk_400_g3d
  - clock-names : From common clock binding : Shall be "g3d" and "aclk_400_g3d"

Example :

	mali {
		compatible = "arm,mali";
		reg = <0x11800000 0x5000>;
		interrupts = <0 118 0>, <0 119 0>, <0 117 0>;
		clocks = <&clock 345>, <&clock 346>;
		clock-names = "g3d", "aclk_400_g3d";
	};
```

## Documentation/devicetree/bindings/arm/exynos/power_domain.txt
```
* Samsung Exynos Power Domains

Exynos processors include support for multiple power domains which are used
to gate power to one or more peripherals on the processor.

Required Properties:
- compatible: should be one of the following.
    * samsung,exynos4210-pd - for exynos4210 type power domain.
- reg: physical base address of the controller and length of memory mapped
    region.
- clocks: List of clock handles. The parent clocks of the input clocks to the
  devices in this power domain are set to oscclk before power gating and
  restored back after powering on a domain. This is required for all domains
  which are powered on and off and not required for unused domains.
  Some devices also have a divider block (CLKDIV2) which provides a second input
  clock. This divider register is a mirror register of the actual register
  inside the ip's domain which gets reset when the power domain is turned off.
  So the CLKDIV2 register needs to be reconfigured upon power on so that the
  internal regisger gets updated correctly. This is done by first setting the
  clock rate to its parent's clock rate and then setting back the original
  clock rate.
  The following clocks can be specified:
  - oscclk: oscillator clock.
  - clk(n): input clock to the devices in this power domain
  - pclk(n): parent clock of input clock to the devices in this power domain
  - dclk(n): second input clock to the devices which is divided by CLKDIV2
	     block.
- enable: enable value of this register which is used to turn on the power
    domain. If no enable is specificed, default value of 0x7 is used.

Node of a device using power domains must have a samsung,power-domain property
defined with a phandle to respective power domain.

Example:

	lcd0: power-domain-lcd0 {
		compatible = "samsung,exynos4210-pd";
		reg = <0x10023C00 0x10>;
	};

	mfc_pd: pd@10044060 {
		compatible = "samsung,exynos4210-pd";
		reg = <0x10044060 0x20>;
		clocks = <&clock 1>, <&clock 1030>, <&clock 1031>,
			 <&clock 2049>;
		clock-names = "oscclk", "pclk0", "clk0" , "dclk0";
	};

	isparm_pd: pd@10042480 {
		compatible = "samsung,exynos4210-pd";
		reg = <0x10042480 0x20>;
		enable = <0x1>;
	};

Example of the node using power domain:

	node {
		/* ... */
		samsung,power-domain = <&lcd0>;
		/* ... */
	};
```

## Documentation/devicetree/bindings/arm/exynos/ppmu-exynos5.txt
```
Exynos5 PPMU driver
-------------------

Performance events are primitive values used to get performance data. These
events provide information about the behavior of the SoC that can be used
when analyzing system performance. These events are made visible using the
PPMU logic.
Exynos5 PPMU driver is used by the exynos5 devfreq driver to control the bus
frequency/voltage.

Required properties:
- compatible: should be one of the following.
	* samsung,exynos5-ppmu - for exynos5250 type ppmu.
- reg:
	* physical base address of the Right PPMU and length of memory mapped
	region

Example:
--------

	ppmu {
		compatible = "samsung,exynos5250-ppmu";
		reg = <0x13660000 0x2000>;
	};
```

## Documentation/devicetree/bindings/clock/exynos5420-clock.txt
```
* Samsung Exynos5420 Clock Controller

The Exynos5420 clock controller generates and supplies clock to various
controllers within the Exynos5420 SoC.

Required Properties:

- comptible: should be one of the following.
  - "samsung,exynos5420-clock" - controller compatible with Exynos5420 SoC.

- reg: physical base address of the controller and length of memory mapped
  region.

- #clock-cells: should be 1.

The following is the list of clocks generated by the controller. Each clock is
assigned an identifier and client nodes use this identifier to specify the
clock which they consume.


       [Core Clocks]

  Clock			ID
  ----------------------------

  fin_pll		1	(AKA oscclk)
  sclk_rpll		2
  fout_epll		3
  sclk_epll		4
  sclk_mpll		5
  sclk_vpll		6
  fout_vpll		7

  [Clock Gate for Special Clocks]

  Clock			ID
  ----------------------------
  sclk_uart0		128
  sclk_uart1		129
  sclk_uart2		130
  sclk_uart3		131
  sclk_mmc0		132
  sclk_mmc1		133
  sclk_mmc2		134
  sclk_spi0		135
  sclk_spi1		136
  sclk_spi2		137
  sclk_i2s1		138
  sclk_i2s2		139
  sclk_pcm1		140
  sclk_pcm2		141
  sclk_spdif		142
  sclk_hdmi		143
  sclk_pixel		144
  sclk_dp1		145
  sclk_mipi1		146
  sclk_fimd1		147
  sclk_maudio0		148
  sclk_maupcm0		149
  sclk_usbd300		150
  sclk_usbd301		151
  sclk_usbphy300	152
  sclk_usbphy301	153
  sclk_unipro		154
  sclk_pwm		155
  sclk_gscl_wa		156
  sclk_gscl_wb		157
  sclk_hdmiphy		158

   [Peripheral Clock Gates]

  Clock			ID
  ----------------------------

  aclk66_peric		256
  pclk_uart0		257
  pclk_uart1		258
  pclk_uart2		259
  pclk_uart3		260
  pclk_i2c0		261
  pclk_i2c1		262
  pclk_i2c2		263
  pclk_i2c3		264
  pclk_usi0		265
  pclk_usi1		266
  pclk_usi2		267
  pclk_usi3		268
  pclk_i2c_hdmi		269
  pclk_tsadc		270
  pclk_spi0		271
  pclk_spi1		272
  pclk_spi2		273
  keyif_unused		274
  pclk_i2s1		275
  pclk_i2s2		276
  pclk_pcm1		277
  pclk_pcm2		278
  pclk_pwm		279
  pclk_spdif		280
  pclk_usi4		281
  pclk_usi5		282
  pclk_usi6		283

  aclk66_psgen		300
  pclk_chipid		301
  pclk_sysreg		302
  pclk_tzpc0		303
  pclk_tzpc1		304
  pclk_tzpc2		305
  pclk_tzpc3		306
  pclk_tzpc4		307
  pclk_tzpc5		308
  pclk_tzpc6		309
  pclk_tzpc7		310
  pclk_tzpc8		311
  pclk_tzpc9		312
  hdmi_cec		313
  seckey		314
  pclk_mct		315
  pclk_wdt		316
  pclk_rtc		317
  pclk_tmu		318
  pclk_tmu_gpu		319

  pclk66_gpio		330

  aclk200_fsys2		350
  mmc0			351
  mmc1			352
  mmc2			353
  sromc			354
  ufs			355

  aclk200_fsys		360
  tsi			361
  pdma0			362
  pdma1			363
  rtic			364
  usbh20		365
  usbd300		366
  usbd301		367

  pclk200_fsys		370

  aclk400_mscl		380
  mscl0			381
  mscl1			382
  mscl2			383
  smmu_mscl0		384
  smmu_mscl1		385
  smmu_mscl2		386

  aclk333		400
  mfc			401
  smmu_mfcl		402
  smmu_mfcr		403

  aclk200_disp1		410
  dsim1			411
  dp1			412
  hdmi			413

  aclk300_disp1		420
  fimd1			421
  smmu_fimd1m0		422
  smmu_fimd1m1		423
  aclk400_disp1		424

  aclk166		430
  mixer			431

  aclk266		440
  aclk_rotator		441
  mdma1			442
  smmu_rotator		443
  smmu_mdma1		444

  aclk300_jpeg		450
  aclk_jpeg		451
  aclk_jpeg2		452
  smmu_jpeg		453

  aclk300_gscl		460
  smmu_gscl0		461
  smmu_gscl1		462
  gscl_wa		463
  gscl_wb		464
  gscl0			465
  gscl1			466
  clk_3aa		467

  aclk266_g2d		470
  sss			471
  slim_sss		472
  mdma0			473

  aclk333_g2d		480
  g2d			481

  aclk333_432_gscl	490
  smmu_3aa		491
  smmu_fimcl0		492
  smmu_fimcl1		493
  smmu_fimcl3		494
  fimc_lite3		495

  aclk_g3d		500
  g3d			501
  smmu_tv		502

  Mux			ID
  ----------------------------

  mout_fimd1		1024
  mout_maudio0		1025
  mout_hdmi		1026
  mout_spi0		1027
  mout_spi1		1028
  mout_spi2		1029
  mout_sw_aclk333	1030
  mout_user_aclk333	1031
  mout_sw_aclk300_gscl	1032
  mout_user_aclk300_gscl	1033
  mout_sw_aclk333_432_gscl	1034
  mout_user_aclk333_432_gscl	1035

Example 1: An example of a clock controller node is listed below.

	clock: clock-controller@0x10010000 {
		compatible = "samsung,exynos5420-clock";
		reg = <0x10010000 0x30000>;
		#clock-cells = <1>;
	};

Example 2: UART controller node that consumes the clock generated by the clock
	   controller. Refer to the standard clock bindings for information
	   about 'clocks' and 'clock-names' property.

	serial@13820000 {
		compatible = "samsung,exynos4210-uart";
		reg = <0x13820000 0x100>;
		interrupts = <0 54 0>;
		clocks = <&clock 259>, <&clock 130>;
		clock-names = "uart", "clk_uart_baud0";
	};
```

## Documentation/devicetree/bindings/drm/exynos/fimd.txt
```
* Samsung Display Controller using DRM frame work

The display controller is used to transfer image data from memory to an
external LCD driver interface. It supports various color formats such as
rgb and yuv.

Required properties:
 - compatible: Should be "samsung,exynos5-fimd" or "samsung,exynos4-fimd" for
   fimd using DRM frame work.
 - reg: physical base address of the controller and length of memory
   mapped region.
 - interrupts: Three interrupts should be specified. The interrupts should be
   specified in the following order.
   - VSYNC interrupt
   - FIFO level interrupt
   - FIMD System Interrupt
 - clocks: List of clock handles. The following must be specified:
   - fimd: Controls gating of aclk_200 to FIMD IP
   - sclk_fimd: Controls gating of FIMD pixel clock
   - mout_fimd: Mux to select parent of sclk_fimd
   - sclk_mout_fimd: Parent clock for mout_fimd
 - clock-names: Aliases for the above clocks. They should be "fimd",
   "sclk_fimd", "mout_fimd", and "sclk_mout_fimd", respectively.
 - samsung,fimd-display: This property should specify the phandle of the
   display device node which holds the video interface timing with the
   below mentioned properties.

 - samsung,default-window: Specifies the default window number of the fimd controller.

 - samsung,fimd-win-bpp: Specifies the bits per pixel.

 - samsung,fimd-src-clk-rate: Specifies the pixel clock rate.

Optional properties:
 - samsung,fimd-vidout-rgb: Video output format is RGB.
 - samsung,fimd-inv-vclk: invert video clock polarity.

Example:

	The following is an example for the fimd controller is split into
	two portions. The SoC specific portion can be specified in the SoC
	specific dts file. The board specific portion can be specified in the
	board specific dts file.

	- SoC Specific portion

	fimd {
		compatible = "samsung,exynos5-fimd";
		interrupt-parent = <&combiner>;
		reg = <0x14400000 0x40000>;
		interrupts = <18 5>, <18 4>, <18 6>;
	};

	- Board Specific portion

	fimd {
		samsung,fimd-vidout-rgb;
		samsung,fimd-inv-vclk;
		samsung,default-window = <0>;
		samsung,fimd-win-bpp = <32>;
	};
```

## Documentation/devicetree/bindings/drm/exynos/hdmi.txt
```
Device-Tree bindings for drm hdmi driver

Required properties:
- compatible: value should be one among the following:
	1) "samsung,exynos4210-hdmi"
	2) "samsung,exynos4212-hdmi"
	3) "samsung,exynos5420-hdmi"
- reg: physical base address of hdmi block and length
	of memory mapped region.
- interrupts: interrupt number to the cpu.
- hpd-gpio: following information about the hotplug gpio pin.
	a) phandle of the gpio controller node.
	b) pin number within the gpio controller.
	c) pin function mode.
	d) optional flags and pull up/down.
	e) drive strength.
- clocks: list of clock IDs from SoC clock driver.
	a) hdmi: It is required for gate operation on aclk_200_disp1 clock
		which clocks the display1 block.
	b) sclk_hdmi: It is required for gate operation on sclk_hdmi clock
		which clocks hdmi IP.
	c) sclk_pixel: Parent for mux mout_hdmi.
	d) sclk_hdmiphy: Parent for mux mout_hdmi.
	e) mout_hdmi: It is required by the driver to switch between the 2
		parents i.e. sclk_pixel and sclk_hdmiphy. If hdmiphy is stable
		after configuration, parent is set to sclk_hdmiphy else
		sclk_pixel.
- clock-names: aliases as per driver requirements for above clock IDs:
	"hdmi", "sclk_hdmi", "sclk_pixel", "sclk_hdmiphy" and "mout_hdmi".
- phy-power-control child node: it is required to control the power to hdmiphy.
	It should provide the following information:
	- reg : base physical address and size of phy control registers
- hdmiphy child node: it is a optional node required for SoCs in which hdmiphy
	is mapped to the platform bus. It is required to map the phy registers
	and configure them for given resolution. This node should provide the
	following information:
        - reg : base physical address and size of hdmiphy configuration
		registers

Example:

	hdmi {
		compatible = "samsung,exynos4212-hdmi";
		reg = <0x14530000 0x100000>;
		interrupts = <0 95 0>;
		hpd-gpio = <&gpx3 7 0xf 1 3>;
		clocks = <&clock 344>, <&clock 136>, <&clock 137>,
				<&clock 157>, <&clock 1024>;
		clock-names = "hdmi", "sclk_hdmi", "sclk_pixel",
				"sclk_hdmiphy", "mout_hdmi";
	};
```

## Documentation/devicetree/bindings/drm/exynos/hdmiddc.txt
```
Device-Tree bindings for hdmiddc driver

Required properties:
- compatible: value should be "samsung,exynos4210-hdmiddc".
- reg: I2C address of the hdmiddc device.

Example:

	hdmiddc {
		compatible = "samsung,exynos4210-hdmiddc";
		reg = <0x50>;
	};
```

## Documentation/devicetree/bindings/drm/exynos/hdmiphy.txt
```
Device-Tree bindings for hdmiphy driver

Required properties:
- compatible: value should be "samsung,exynos4210-hdmiphy".
- reg: I2C address of the hdmiphy device.

Example:

	hdmiphy {
		compatible = "samsung,exynos4210-hdmiphy";
		reg = <0x38>;
	};
```

## Documentation/devicetree/bindings/drm/exynos/mixer.txt
```
Device-Tree bindings for mixer driver

Required properties:
- compatible: value should be:
	1) "samsung,exynos4210-mixer"
	2) "samsung,exynos5250-mixer"
	3) "samsung,exynos5420-mixer"
- reg: physical base address of the mixer and length of memory mapped
	region.
- interrupts: interrupt number to the cpu.
- clocks: list of clock IDs from SoC clock driver.
	a) mixer: It is required for gate operation on aclk_200_disp1 clock
		which clocks the display1 block.
	b) sclk_hdmi: Parent for mux mout_mixer.

Example:

	mixer {
		compatible = "samsung,exynos5250-mixer";
		reg = <0x14450000 0x10000>;
		interrupts = <0 94 0>;
		clocks = <&clock 343>, <&clock 136>;
		clock-names = "mixer", "sclk_hdmi";
	};
```
